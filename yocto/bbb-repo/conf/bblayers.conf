## yocto/stm32mp1/conf/bblayers.conf
```bitbake
# POKY_BBLAYERS_CONF_VERSION is increased each time build/conf/bblayers.conf
# changes incompatibly
POKY_BBLAYERS_CONF_VERSION = "2"

BBPATH = "${TOPDIR}"
BBFILES ?= ""

LEARNING_TOPDIR = "${@os.path.abspath(os.path.join('${TOPDIR}', os.pardir))}"

LEARNING_LAYERDIR = "${LEARNING_TOPDIR}/layers"
LEARNING_UPSTREAMDIR = "${LEARNING_TOPDIR}/upstream"

BBLAYERS ?= " \
  ${LEARNING_UPSTREAMDIR}/poky/meta \
  ${LEARNING_UPSTREAMDIR}/poky/meta-poky \
  ${LEARNING_UPSTREAMDIR}/poky/meta-yocto-bsp \
  ${LEARNING_UPSTREAMDIR}/meta-st-stm32mp \
  ${LEARNING_UPSTREAMDIR}/meta-openembedded/meta-oe \
  ${LEARNING_UPSTREAMDIR}/meta-openembedded/meta-python \
  "
```
