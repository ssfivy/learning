## yocto/bbb-repo/conf/bblayers.conf
```bitbake
# POKY_BBLAYERS_CONF_VERSION is increased each time build/conf/bblayers.conf
# changes incompatibly
POKY_BBLAYERS_CONF_VERSION = "2"

BBPATH = "${TOPDIR}"
BBFILES ?= ""

# This path should point to the cockatoo top directory
COCKATOODIR = "${@os.path.abspath(os.path.join('${TOPDIR}', os.pardir))}"

# poky layers
BBLAYERS = " \
  ${COCKATOODIR}/upstream/poky/meta \
  ${COCKATOODIR}/upstream/poky/meta-poky \
  ${COCKATOODIR}/upstream/poky/meta-yocto-bsp \
  "

# other upstream layers
BBLAYERS += " \
  ${COCKATOODIR}/upstream/meta-openembedded/meta-oe \
"

# my layers
BBLAYERS += " \
  ${COCKATOODIR}/meta-cockatoo \
"
```

## yocto/bbb/conf/bblayers.conf
```bitbake
# POKY_BBLAYERS_CONF_VERSION is increased each time build/conf/bblayers.conf
# changes incompatibly
POKY_BBLAYERS_CONF_VERSION = "2"

BBPATH = "${TOPDIR}"
BBFILES ?= ""


LEARNING_TOPDIR = "${@os.path.abspath(os.path.join('${TOPDIR}', os.pardir))}"

LEARNING_LAYERDIR = "${LEARNING_TOPDIR}/bbb/layers"
LEARNING_UPSTREAMDIR = "${LEARNING_TOPDIR}/upstream"

BBLAYERS ?= " \
  ${LEARNING_UPSTREAMDIR}/poky/meta \
  ${LEARNING_UPSTREAMDIR}/poky/meta-poky \
  ${LEARNING_UPSTREAMDIR}/poky/meta-yocto-bsp \
  ${LEARNING_LAYERDIR}/meta-bbb-experiments \
  "
```

## yocto/bbb/layers/meta-bbb-experiments/conf/layer.conf
```bitbake
# We have a conf and classes directory, add to BBPATH
BBPATH .= ":${LAYERDIR}"

# We have recipes-* directories, add to BBFILES
BBFILES += "${LAYERDIR}/recipes-*/*/*.bb \
            ${LAYERDIR}/recipes-*/*/*.bbappend"

BBFILE_COLLECTIONS += "bbb-experiments"
BBFILE_PATTERN_bbb-experiments = "^${LAYERDIR}/"
BBFILE_PRIORITY_bbb-experiments = "6"

LAYERDEPENDS_bbb-experiments = "core"
LAYERSERIES_COMPAT_bbb-experiments = "dunfell"
```

## yocto/imx7-browser/conf/bblayers.conf
```bitbake
# POKY_BBLAYERS_CONF_VERSION is increased each time build/conf/bblayers.conf
# changes incompatibly
POKY_BBLAYERS_CONF_VERSION = "2"

BBPATH = "${TOPDIR}"
BBFILES ?= ""

# This path should point to the cockatoo top directory
COCKATOODIR = "${@os.path.abspath(os.path.join('${TOPDIR}', os.pardir, os.pardir, os.pardir))}"

UPSTREAM = "${@os.path.basename(os.path.abspath(os.path.join('${TOPDIR}', os.pardir)))}"

# poky layers
BBLAYERS = " \
  ${COCKATOODIR}/${UPSTREAM}/poky/meta \
  ${COCKATOODIR}/${UPSTREAM}/poky/meta-poky \
  ${COCKATOODIR}/${UPSTREAM}/poky/meta-yocto-bsp \
  "

# other layers
BBLAYERS += " \
  ${COCKATOODIR}/${UPSTREAM}/meta-openembedded/meta-oe \
  ${COCKATOODIR}/${UPSTREAM}/meta-gplv2 \
  ${COCKATOODIR}/${UPSTREAM}/meta-freescale \
  ${COCKATOODIR}/${UPSTREAM}/meta-browser \
  ${COCKATOODIR}/${UPSTREAM}/meta-clang \
"

# my layers
BBLAYERS += " \
  ${COCKATOODIR}/meta-cockatoo \
"
```
